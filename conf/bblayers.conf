## conf/bblayers.conf
```bitbake
# POKY_BBLAYERS_CONF_VERSION is increased each time build/conf/bblayers.conf
# changes incompatibly
POKY_BBLAYERS_CONF_VERSION = "2"

BBPATH = "${TOPDIR}"
BBFILES ?= ""

BBLAYERS ?= " \
  ${TOPDIR}/../meta \
  ${TOPDIR}/../meta-poky \
  ${TOPDIR}/../meta-yocto-bsp \
  ${TOPDIR}/../../metas/meta-openembedded/meta-multimedia \
  ${TOPDIR}/../../metas/meta-openembedded/meta-oe \
  ${TOPDIR}/../../metas/meta-openembedded/meta-python \
  ${TOPDIR}/../../metas/meta-openembedded/meta-networking \
  ${TOPDIR}/../../metas/meta-iot-cloud \
  ${TOPDIR}/../../metas/meta-java \ 
  ${TOPDIR}/../../metas/meta-maintec \
  "
```

## metas/meta-maintec/conf/layer.conf
```bitbake
# We have a conf and classes directory, add to BBPATH
BBPATH .= ":${LAYERDIR}"

# We have recipes-* directories, add to BBFILES
BBFILES += "${LAYERDIR}/recipes-*/*/*.bb \
            ${LAYERDIR}/recipes-*/*/*.bbappend"

BBFILE_COLLECTIONS += "meta-maintec"
BBFILE_PATTERN_meta-maintec = "^${LAYERDIR}/"
BBFILE_PRIORITY_meta-maintec = "6"

LAYERDEPENDS_meta-maintec = "core"
LAYERSERIES_COMPAT_meta-maintec = "thud"
```
